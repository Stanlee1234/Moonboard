#include <Wire.h>
#include <Adafruit_GFX.h>
#include <Adafruit_SSD1306.h>
#include <Adafruit_MPU6050.h>
#include <DHT.h>
#include <math.h>

// pinout for xiao esp32-c3
const int I2C_SDA_PIN = 6;
const int I2C_SCL_PIN = 7;
const int DHT_PIN = 2;
const int POT_PIN = 10;

const int ROW_PINS[2] = {21, 20};
const int COL_PINS[3] = {3, 4, 5};

const bool USE_DHT11 = true;
const uint8_t OLED_ADDRESS = 0x3C;
const uint8_t MPU6050_ADDRESS = 0x68;

// top row: gyro (sw1), menu (sw2), pot (sw3)
// bottom row: phase cycle (sw4), pet (sw5), hop (sw6)
enum MatrixKey {
  KEY_SW1 = 0,
  KEY_SW2 = 1,
  KEY_SW3 = 2,
  KEY_SW4 = 3,
  KEY_SW5 = 4,
  KEY_SW6 = 5,
  NUM_KEYS = 6
};

const char* const KEY_LABELS[NUM_KEYS] = {
  "SW1", "SW2", "SW3", "SW4", "SW5", "SW6"
};

const float SHAKE_THRESHOLD = 7.0f;
const uint16_t SHAKE_COOLDOWN_MS = 650;
const float STANDARD_GRAVITY = 9.80665f;

const int PET_SPRITE_WIDTH = 32;
const int PET_SPRITE_HEIGHT = 32;

// 8 moon phases (32x32)
const uint8_t PROGMEM MOON_PHASE_BITMAPS[8][128] = {
  {
    0x00, 0x00, 0x00, 0x00, 0x00, 0x0F, 0xF0, 0x00, 0x00, 0x7F, 0xFE, 0x00, 0x01, 0xFF, 0xFF, 0x80,
    0x03, 0xE0, 0x07, 0xC0, 0x07, 0x80, 0x01, 0xE0, 0x0F, 0x00, 0x00, 0xF0, 0x1E, 0x00, 0x00, 0x78,
    0x1C, 0x00, 0x00, 0x38, 0x38, 0x00, 0x00, 0x1C, 0x38, 0x00, 0x00, 0x1C, 0x70, 0x00, 0x00, 0x0E,
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    0x00, 0x7F, 0xFE, 0x00, 0x00, 0x0F, 0xF0, 0x00, 0x00, 0x00, 0x00, 0x00, 0x00, 0x00, 0x00, 0x00
  },
  {
    0x00, 0x00, 0x00, 0x00, 0x00, 0x0F, 0xF0, 0x00, 0x00, 0x7F, 0xFE, 0x00, 0x01, 0xFF, 0xFF, 0x80,
    0x03, 0xE0, 0x0F, 0xC0, 0x07, 0x80, 0x07, 0xE0, 0x0F, 0x00, 0x03, 0xF0, 0x1E, 0x00, 0x03, 0x78,
    0x1C, 0x00, 0x03, 0x38, 0x38, 0x00, 0x03, 0x9C, 0x38, 0x00, 0x03, 0xDC, 0x70, 0x00, 0x03, 0xCE,
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    0x00, 0x7F, 0xFE, 0x00, 0x00, 0x0F, 0xF0, 0x00, 0x00, 0x00, 0x00, 0x00, 0x00, 0x00, 0x00, 0x00
  },
  {
    0x00, 0x00, 0x00, 0x00, 0x00, 0x0F, 0xF0, 0x00, 0x00, 0x7F, 0xFE, 0x00, 0x01, 0xFF, 0xFF, 0x80,
    0x03, 0xE0, 0x7F, 0xC0, 0x07, 0x80, 0x3F, 0xE0, 0x0F, 0x00, 0x1F, 0xF0, 0x1E, 0x00, 0x1F, 0xF8,
    0x1C, 0x00, 0x1F, 0xF8, 0x38, 0x00, 0x1F, 0xFC, 0x38, 0x00, 0x1F, 0xFC, 0x70, 0x00, 0x0F, 0xFE,
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    0x00, 0x7F, 0xFE, 0x00, 0x00, 0x0F, 0xF0, 0x00, 0x00, 0x00, 0x00, 0x00, 0x00, 0x00, 0x00, 0x00
  },
  {
    0x00, 0x00, 0x00, 0x00, 0x00, 0x0F, 0xF0, 0x00, 0x00, 0x7F, 0xFE, 0x00, 0x01, 0xFF, 0xFF, 0x80,
    0x03, 0xEF, 0xFF, 0xC0, 0x07, 0xDF, 0xFF, 0xE0, 0x0F, 0xBF, 0xFF, 0xF0, 0x1E, 0xBF, 0xFF, 0xF8,
    0x1C, 0x7F, 0xFF, 0xF8, 0x38, 0x7F, 0xFF, 0xFC, 0x38, 0x7F, 0xFF, 0xFC, 0x70, 0x3F, 0xFF, 0xFE,
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    0x00, 0x7F, 0xFE, 0x00, 0x00, 0x0F, 0xF0, 0x00, 0x00, 0x00, 0x00, 0x00, 0x00, 0x00, 0x00, 0x00
  },
  {
    0x00, 0x00, 0x00, 0x00, 0x00, 0x0F, 0xF0, 0x00, 0x00, 0x7F, 0xFE, 0x00, 0x01, 0xFF, 0xFF, 0x80,
    0x03, 0xFF, 0xFF, 0xC0, 0x07, 0xFF, 0xFF, 0xE0, 0x0F, 0xFF, 0xFF, 0xF0, 0x1F, 0xFF, 0xFF, 0xF8,
    0x1F, 0xFF, 0xFF, 0xF8, 0x3F, 0xFF, 0xFF, 0xFC, 0x3F, 0xFF, 0xFF, 0xFC, 0x7F, 0xFF, 0xFF, 0xFE,
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    0x00, 0x7F, 0xFE, 0x00, 0x00, 0x0F, 0xF0, 0x00, 0x00, 0x00, 0x00, 0x00, 0x00, 0x00, 0x00, 0x00
  },
  {
    0x00, 0x00, 0x00, 0x00, 0x00, 0x0F, 0xF0, 0x00, 0x00, 0x7F, 0xFE, 0x00, 0x01, 0xFF, 0xFF, 0x80,
    0x03, 0xFF, 0xF7, 0xC0, 0x07, 0xFF, 0xFB, 0xE0, 0x0F, 0xFF, 0xFD, 0xF0, 0x1F, 0xFF, 0xFD, 0xF8,
    0x1F, 0xFF, 0xFE, 0x38, 0x3F, 0xFF, 0xFE, 0x3C, 0x3F, 0xFF, 0xFE, 0x3C, 0x7F, 0xFF, 0xFC, 0x7E,
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    0x00, 0x7F, 0xFE, 0x00, 0x00, 0x0F, 0xF0, 0x00, 0x00, 0x00, 0x00, 0x00, 0x00, 0x00, 0x00, 0x00
  },
  {
    0x00, 0x00, 0x00, 0x00, 0x00, 0x0F, 0xF0, 0x00, 0x00, 0x7F, 0xFE, 0x00, 0x01, 0xFF, 0xFF, 0x80,
    0x03, 0xFE, 0x07, 0xC0, 0x07, 0xFC, 0x01, 0xE0, 0x0F, 0xF8, 0x00, 0xF0, 0x1F, 0xF8, 0x00, 0x78,
    0x1F, 0xF8, 0x00, 0x38, 0x3F, 0xF8, 0x00, 0x1C, 0x3F, 0xF8, 0x00, 0x1C, 0x7F, 0xF0, 0x00, 0x0E,
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    0x00, 0x7F, 0xFE, 0x00, 0x00, 0x0F, 0xF0, 0x00, 0x00, 0x00, 0x00, 0x00, 0x00, 0x00, 0x00, 0x00
  },
  {
    0x00, 0x00, 0x00, 0x00, 0x00, 0x0F, 0xF0, 0x00, 0x00, 0x7F, 0xFE, 0x00, 0x01, 0xFF, 0xFF, 0x80,
    0x03, 0xF0, 0x07, 0xC0, 0x07, 0xE0, 0x01, 0xE0, 0x0F, 0xC0, 0x00, 0xF0, 0x1E, 0xC0, 0x00, 0x78,
    0x1C, 0xC0, 0x00, 0x38, 0x39, 0xC0, 0x00, 0x1C, 0x3B, 0xC0, 0x00, 0x1C, 0x73, 0xC0, 0x00, 0x0E,
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    0x00, 0x7F, 0xFE, 0x00, 0x00, 0x0F, 0xF0, 0x00, 0x00, 0x00, 0x00, 0x00, 0x00, 0x00, 0x00, 0x00
  }
};

const int SCREEN_WIDTH = 128;
const int SCREEN_HEIGHT = 64;
const uint16_t MATRIX_DEBOUNCE_MS = 25;
const uint16_t MPU_READ_INTERVAL_MS = 30;
const uint16_t DHT_READ_INTERVAL_MS = 2000;

Adafruit_SSD1306 display(SCREEN_WIDTH, SCREEN_HEIGHT, &Wire, -1);
Adafruit_MPU6050 mpu;
DHT dht(DHT_PIN, DHT11);

enum View {
  MENU_VIEW,
  GYRO_VIEW,
  POT_VIEW,
};

View currentView = MENU_VIEW;

bool keyIsDown[NUM_KEYS];
bool keyJustPressed[NUM_KEYS];
bool keyPrevState[NUM_KEYS];
uint32_t keyLastChange[NUM_KEYS];
int lastPressedKeyIndex = -1;

bool mpuFound = false;
bool dhtFound = false;
float accelerationX = 0.0f;
float accelerationY = 0.0f;
float accelerationZ = STANDARD_GRAVITY;
float gyroX = 0.0f;
float gyroY = 0.0f;
float gyroZ = 0.0f;
float mpuTemperatureC = NAN;
float dhtTemperatureC = NAN;
float dhtHumidity = NAN;
float tiltRoll = 0.0f;
float tiltPitch = 0.0f;
bool shakeDetected = false;
uint32_t lastShakeAt = 0;
uint32_t shakeActiveUntil = 0;

uint8_t currentMoonPhase = 4;
uint32_t heartAnimationEndsAt = 0;
uint32_t lastDhtReadAt = 0;
uint32_t lastMpuReadAt = 0;

int keepInRange(int value, int smallest, int largest) {
  return constrain(value, smallest, largest);
}

int readPotentiometer() {
  int raw = analogRead(POT_PIN);
  if (raw > 0) {
    return keepInRange(map(raw, 0, 4095, 0, 100), 0, 100);
  }
  // c3 has no adc on gpio10, fallback to digital
  return (digitalRead(POT_PIN) == HIGH) ? 100 : 0;
}

void triggerHearts() {
  heartAnimationEndsAt = millis() + 1500;
}

void drawHeart(int x, int y) {
  display.fillRect(x - 2, y, 2, 2, SSD1306_WHITE);
  display.fillRect(x + 1, y, 2, 2, SSD1306_WHITE);
  display.fillRect(x - 3, y + 2, 7, 2, SSD1306_WHITE);
  display.fillRect(x - 2, y + 4, 5, 1, SSD1306_WHITE);
  display.fillRect(x - 1, y + 5, 3, 1, SSD1306_WHITE);
  display.drawPixel(x, y + 6, SSD1306_WHITE);
}

void drawHeartsAnim(uint32_t now, int petX, int petY) {
  if (now >= heartAnimationEndsAt) return;
  const float progress = 1.0f - static_cast<float>(heartAnimationEndsAt - now) / 1500.0f;
  const int rise = static_cast<int>(progress * 16.0f);
  drawHeart(petX + 10, petY - 3 - rise);
  drawHeart(petX + 22, petY - 8 - rise / 2);
}

void setUpKeyMatrix() {
  for (int i = 0; i < 2; i++) {
    pinMode(ROW_PINS[i], INPUT);
  }
  for (int i = 0; i < 3; i++) {
    pinMode(COL_PINS[i], INPUT_PULLUP);
  }
  for (int i = 0; i < NUM_KEYS; i++) {
    keyIsDown[i] = false;
    keyJustPressed[i] = false;
    keyPrevState[i] = false;
    keyLastChange[i] = 0;
  }
}

void updateKeyMatrix() {
  const uint32_t now = millis();
  for (int i = 0; i < NUM_KEYS; i++) {
    keyJustPressed[i] = false;
  }

  // active-low matrix scan
  for (int r = 0; r < 2; r++) {
    pinMode(ROW_PINS[r], OUTPUT);
    digitalWrite(ROW_PINS[r], LOW);
    delayMicroseconds(5);

    for (int c = 0; c < 3; c++) {
      int keyIndex = r * 3 + c;
      bool rawDown = (digitalRead(COL_PINS[c]) == LOW);

      if (rawDown != keyPrevState[keyIndex]) {
        if (now - keyLastChange[keyIndex] >= MATRIX_DEBOUNCE_MS) {
          keyLastChange[keyIndex] = now;
          keyPrevState[keyIndex] = rawDown;

          if (rawDown && !keyIsDown[keyIndex]) {
            keyIsDown[keyIndex] = true;
            keyJustPressed[keyIndex] = true;
            lastPressedKeyIndex = keyIndex;
          } else if (!rawDown && keyIsDown[keyIndex]) {
            keyIsDown[keyIndex] = false;
          }
        }
      }
    }
    pinMode(ROW_PINS[r], INPUT);
  }
}

void updateMpu() {
  if (!mpuFound || millis() - lastMpuReadAt < MPU_READ_INTERVAL_MS) {
    return;
  }
  lastMpuReadAt = millis();

  sensors_event_t a, g, temp;
  mpu.getEvent(&a, &g, &temp);

  accelerationX = a.acceleration.x;
  accelerationY = a.acceleration.y;
  accelerationZ = a.acceleration.z;
  gyroX = g.gyro.x;
  gyroY = g.gyro.y;
  gyroZ = g.gyro.z;
  mpuTemperatureC = temp.temperature;

  tiltRoll  = atan2f(accelerationY, accelerationZ) * (180.0f / PI);
  tiltPitch = atan2f(-accelerationX, sqrtf(accelerationY * accelerationY + accelerationZ * accelerationZ)) * (180.0f / PI);

  const float magnitude = sqrtf(accelerationX * accelerationX +
                                accelerationY * accelerationY +
                                accelerationZ * accelerationZ);
  const uint32_t now = millis();
  if (fabsf(magnitude - STANDARD_GRAVITY) >= SHAKE_THRESHOLD &&
      now - lastShakeAt >= SHAKE_COOLDOWN_MS) {
    lastShakeAt = now;
    shakeActiveUntil = now + 400;
    shakeDetected = true;
  }

  if (now > shakeActiveUntil) {
    shakeDetected = false;
  }
}

void updateDht() {
  if (!dhtFound || millis() - lastDhtReadAt < DHT_READ_INTERVAL_MS) {
    return;
  }
  lastDhtReadAt = millis();

  const float newH = dht.readHumidity();
  const float newT = dht.readTemperature();
  if (!isnan(newH)) dhtHumidity = newH;
  if (!isnan(newT)) dhtTemperatureC = newT;
}

void drawMenuView() {
  display.clearDisplay();

  display.setTextSize(1);
  display.setTextColor(SSD1306_WHITE);
  display.setCursor(2, 0);
  display.print(F("MOONBOARD TESTER"));
  display.drawFastHLine(0, 9, SCREEN_WIDTH, SSD1306_WHITE);

  // 6 buttons on screen
  const int boxW = 19;
  const int boxH = 13;
  const int startX = 3;
  const int startY = 12;
  const int gapX = 3;
  const int gapY = 3;

  for (int r = 0; r < 2; r++) {
    for (int c = 0; c < 3; c++) {
      int idx = r * 3 + c;
      int bx = startX + c * (boxW + gapX);
      int by = startY + r * (boxH + gapY);

      if (keyIsDown[idx]) {
        display.fillRect(bx, by, boxW, boxH, SSD1306_WHITE);
        display.setTextColor(SSD1306_BLACK);
        display.setCursor(bx + 2, by + 3);
        display.print(KEY_LABELS[idx]);
      } else {
        display.drawRect(bx, by, boxW, boxH, SSD1306_WHITE);
        display.setTextColor(SSD1306_WHITE);
        display.setCursor(bx + 2, by + 3);
        display.print(KEY_LABELS[idx]);
      }
    }
  }

  display.setTextColor(SSD1306_WHITE);
  display.setCursor(70, 12);
  display.print(F("TEMP:"));
  display.setCursor(70, 21);
  if (!isnan(dhtTemperatureC)) {
    display.print(dhtTemperatureC, 1);
    display.print(F("C"));
  } else if (!isnan(mpuTemperatureC)) {
    display.print(mpuTemperatureC, 1);
    display.print(F("C*"));
  } else {
    display.print(F("--.-C"));
  }

  display.setCursor(70, 31);
  display.print(F("HUMID:"));
  display.setCursor(70, 40);
  if (!isnan(dhtHumidity)) {
    display.print((int)dhtHumidity);
    display.print(F(" %"));
  } else {
    display.print(F("-- %"));
  }

  const uint32_t now = millis();
  int floatOffset = static_cast<int>(sinf(now / 350.0f) * 1.5f);
  int petX = 104;
  int petY = 12 + floatOffset;

  display.drawBitmap(petX, petY, MOON_PHASE_BITMAPS[currentMoonPhase], PET_SPRITE_WIDTH, PET_SPRITE_HEIGHT, SSD1306_WHITE);

  display.fillRect(petX + 11, petY + 14, 2, 2, SSD1306_INVERSE);
  display.fillRect(petX + 19, petY + 14, 2, 2, SSD1306_INVERSE);
  display.drawFastHLine(petX + 14, petY + 18, 4, SSD1306_INVERSE);

  drawHeartsAnim(now, petX, petY);

  display.drawFastHLine(0, 47, SCREEN_WIDTH, SSD1306_WHITE);
  display.setCursor(2, 51);

  if (lastPressedKeyIndex >= 0 && keyIsDown[lastPressedKeyIndex]) {
    display.print(F("* "));
    display.print(KEY_LABELS[lastPressedKeyIndex]);
    display.print(F(" PRESSED *"));
  } else {
    display.print(F("SW1:GYRO   SW3:POT"));
  }
}

void drawGyroView() {
  display.clearDisplay();

  display.setTextSize(1);
  display.setTextColor(SSD1306_WHITE);
  display.setCursor(2, 1);
  display.print(F("GYRO & IMU TEST"));
  display.drawFastHLine(0, 9, SCREEN_WIDTH, SSD1306_WHITE);

  // bubble level crosshair
  const int boxX = 6;
  const int boxY = 13;
  const int boxSize = 40;

  display.drawRect(boxX, boxY, boxSize, boxSize, SSD1306_WHITE);
  display.drawFastHLine(boxX + 2, boxY + boxSize / 2, boxSize - 4, SSD1306_WHITE);
  display.drawFastVLine(boxX + boxSize / 2, boxY + 2, boxSize - 4, SSD1306_WHITE);
  display.drawCircle(boxX + boxSize / 2, boxY + boxSize / 2, 6, SSD1306_WHITE);

  int bubbleX = (boxX + boxSize / 2) + keepInRange(static_cast<int>(tiltRoll / 2.5f), -16, 16);
  int bubbleY = (boxY + boxSize / 2) + keepInRange(static_cast<int>(tiltPitch / 2.5f), -16, 16);
  display.fillCircle(bubbleX, bubbleY, 3, SSD1306_WHITE);

  display.setCursor(54, 13);
  display.print(F("Roll:  "));
  display.print(static_cast<int>(tiltRoll));
  display.print((char)247);

  display.setCursor(54, 23);
  display.print(F("Pitch: "));
  display.print(static_cast<int>(tiltPitch));
  display.print((char)247);

  display.setCursor(54, 33);
  display.print(F("Temp:  "));
  if (!isnan(mpuTemperatureC)) {
    display.print(mpuTemperatureC, 1);
    display.print(F("C"));
  } else {
    display.print(F("--.-C"));
  }

  display.setCursor(54, 43);
  if (shakeDetected) {
    display.print(F("SHAKE!"));
  } else {
    display.print(F("Motion OK"));
  }

  display.drawFastHLine(0, 55, SCREEN_WIDTH, SSD1306_WHITE);
  display.setCursor(14, 57);
  display.print(F("[SW2] Back to Menu"));
}

void drawPotView() {
  display.clearDisplay();

  display.setTextSize(1);
  display.setTextColor(SSD1306_WHITE);
  display.setCursor(2, 1);
  display.print(F("POTENTIOMETER TEST"));
  display.drawFastHLine(0, 9, SCREEN_WIDTH, SSD1306_WHITE);

  int percent = readPotentiometer();
  int rawVal = analogRead(POT_PIN);

  const int barX = 14;
  const int barY = 16;
  const int barW = 100;
  const int barH = 14;

  display.drawRect(barX, barY, barW, barH, SSD1306_WHITE);
  int fillWidth = map(percent, 0, 100, 0, barW - 4);
  if (fillWidth > 0) {
    display.fillRect(barX + 2, barY + 2, fillWidth, barH - 4, SSD1306_WHITE);
  }

  display.drawFastVLine(barX + barW / 4, barY + barH, 3, SSD1306_WHITE);
  display.drawFastVLine(barX + barW / 2, barY + barH, 4, SSD1306_WHITE);
  display.drawFastVLine(barX + (3 * barW) / 4, barY + barH, 3, SSD1306_WHITE);

  display.setCursor(18, 35);
  display.print(F("Level:   "));
  display.print(percent);
  display.print(F(" %"));

  display.setCursor(18, 45);
  display.print(F("Pin D10: "));
  display.print((percent > 50) ? F("HIGH") : F("LOW"));
  display.print(F(" (raw "));
  display.print(rawVal);
  display.print(F(")"));

  display.drawFastHLine(0, 55, SCREEN_WIDTH, SSD1306_WHITE);
  display.setCursor(14, 57);
  display.print(F("[SW2] Back to Menu"));
}

void drawCurrentView() {
  if (currentView == GYRO_VIEW) {
    drawGyroView();
  } else if (currentView == POT_VIEW) {
    drawPotView();
  } else {
    drawMenuView();
  }
  display.display();
}

void setup() {
  Serial.begin(115200);

  Wire.begin(I2C_SDA_PIN, I2C_SCL_PIN);
  Wire.setClock(400000);

  setUpKeyMatrix();
  pinMode(POT_PIN, INPUT);

  if (!display.begin(SSD1306_SWITCHCAPVCC, OLED_ADDRESS)) {
    Serial.println(F("[WARN] OLED not found"));
  } else {
    display.clearDisplay();
    display.setTextSize(1);
    display.setTextColor(SSD1306_WHITE);
    display.setCursor(16, 20);
    display.println(F("MOONBOARD v1.0"));
    display.setCursor(16, 35);
    display.println(F("Starting Suite..."));
    display.display();
  }

  mpuFound = mpu.begin(MPU6050_ADDRESS, &Wire);
  if (mpuFound) {
    mpu.setAccelerometerRange(MPU6050_RANGE_8_G);
    mpu.setGyroRange(MPU6050_RANGE_500_DEG);
    mpu.setFilterBandwidth(MPU6050_BAND_21_HZ);
  }

  if (USE_DHT11) {
    dht.begin();
    dhtFound = true;
  }

  delay(600);
}

void loop() {
  updateKeyMatrix();
  updateMpu();
  updateDht();

  // sw1 = gyro, sw3 = pot, sw2 = back to menu
  if (keyJustPressed[KEY_SW1]) {
    currentView = GYRO_VIEW;
  } else if (keyJustPressed[KEY_SW3]) {
    currentView = POT_VIEW;
  } else if (keyJustPressed[KEY_SW2]) {
    currentView = MENU_VIEW;
  } else if (keyJustPressed[KEY_SW4]) {
    currentMoonPhase = (currentMoonPhase + 1) % 8;
  } else if (keyJustPressed[KEY_SW5] || keyJustPressed[KEY_SW6]) {
    triggerHearts();
  }

  drawCurrentView();
  delay(16);
}
